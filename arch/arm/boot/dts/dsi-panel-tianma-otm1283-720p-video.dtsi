/* Copyright (c) 2012-2013, The Linux Foundation. All rights reserved.
 *
 * This program is free software; you can redistribute it and/or modify
 * it under the terms of the GNU General Public License version 2 and
 * only version 2 as published by the Free Software Foundation.
 *
 * This program is distributed in the hope that it will be useful,
 * but WITHOUT ANY WARRANTY; without even the implied warranty of
 * MERCHANTABILITY or FITNESS FOR A PARTICULAR PURPOSE.  See the
 * GNU General Public License for more details.
 */

/*---------------------------------------------------------------------------
 * This file is autogenerated file using gcdb parser. Please do not edit it.
 * Update input XML file to add a new entry or update variable in this file
 * VERSION = "1.0"
 *---------------------------------------------------------------------------*/
&mdss_mdp {
	dsi_tianma_720_vid: qcom,mdss_dsi_tianma_otm1283a_720p_video {
		qcom,mdss-dsi-panel-name = "tianma otm1283a 720p video mode dsi panel";
		qcom,mdss-dsi-panel-controller = <&mdss_dsi0>;
		qcom,mdss-dsi-panel-type = "dsi_video_mode";
		qcom,mdss-dsi-panel-destination = "display_1";
		qcom,mdss-dsi-panel-framerate = <60>;
		qcom,mdss-dsi-virtual-channel-id = <0>;
		qcom,mdss-dsi-stream = <0>;
		qcom,mdss-dsi-panel-width = <720>;
		qcom,mdss-dsi-panel-height = <1280>;
		qcom,mdss-dsi-h-front-porch = <79>;
		qcom,mdss-dsi-h-back-porch = <59>;
		qcom,mdss-dsi-h-pulse-width = <60>;
		qcom,mdss-dsi-h-sync-skew = <0>;
		qcom,mdss-dsi-v-back-porch = <14>;
		qcom,mdss-dsi-v-front-porch = <16>;
		qcom,mdss-dsi-v-pulse-width = <2>;
		qcom,mdss-dsi-h-left-border = <0>;
		qcom,mdss-dsi-h-right-border = <0>;
		qcom,mdss-dsi-v-top-border = <0>;
		qcom,mdss-dsi-v-bottom-border = <0>;
		qcom,mdss-dsi-bpp = <24>;
		qcom,mdss-dsi-color-order = "rgb_swap_rgb";
		qcom,mdss-dsi-underflow-color = <0x0>;
		qcom,mdss-dsi-border-color = <0>;
		qcom,mdss-dsi-on-command = [
				29 01 00 00 00 00 02 00 00
				29 01 00 00 00 00 04 ff 12 83 01

				29 01 00 00 00 00 02 00 80
				29 01 00 00 00 00 03 ff 12 83

				29 01 00 00 00 00 02 00 80
				29 01 00 00 00 00 0a c0 00 64
				00 0e 12 00 64 0e 12

				29 01 00 00 00 00 02 00 b4
				29 01 00 00 00 00 02 c0 55

				29 01 00 00 00 00 02 00 80
//				29 01 00 00 00 00 02 c4 30
				29 01 00 00 00 00 02 c4 01
				
				29 01 00 00 00 00 02 00 88
				29 01 00 00 00 00 02 c4 80
				
				29 01 00 00 00 00 02 00 c2
				29 01 00 00 00 00 02 f5 c0
				
				29 01 00 00 00 00 02 00 8a
				29 01 00 00 00 00 02 c4 40

				29 01 00 00 00 00 02 00 81
				29 01 00 00 00 00 02 c1 66

				29 01 00 00 00 00 02 00 a0
				29 01 00 00 00 00 02 c1 02

				29 01 00 00 00 00 02 00 81
				29 01 00 00 00 00 02 c4 82



		
				29 01 00 00 00 00 02 00 90
				29 01 00 00 00 00 02 c4 52



				29 01 00 00 00 00 02 00 82
				29 01 00 00 00 00 02 c4 02

				29 01 00 00 00 00 02 00 c6
				29 01 00 00 00 00 02 b0 03

				29 01 00 00 00 00 02 00 a0
				29 01 00 00 00 00 0f c4 05 10
				06 02 05 15 10 05 10 07 02 05
				15 10

				29 01 00 00 00 00 02 00 b0
				29 01 00 00 00 00 03 c4 00 00

				29 01 00 00 00 00 02 00 bb
				29 01 00 00 00 00 02 c5 80

				29 01 00 00 00 00 02 00 91
				29 01 00 00 00 00 03 c5 16 50

				29 01 00 00 00 00 02 00 00
				29 01 00 00 00 00 03 d8 9d 9d

//				29 01 00 00 00 00 02 00 00
//				29 01 00 00 00 00 02 d9 65

				29 01 00 00 00 00 02 00 b0
				29 01 00 00 00 00 03 c5 04 b8

				29 01 00 00 00 00 02 00 90
				29 01 00 00 00 00 05 f5 02
				11 02 11

				29 01 00 00 00 00 02 00 90
				29 01 00 00 00 00 02 c5 50

				29 01 00 00 00 00 02 00 94
				29 01 00 00 00 00 02 c5 66

				29 01 00 00 00 00 02 00 b2
				29 01 00 00 00 00 03 f5 00 00

				29 01 00 00 00 00 02 00 b4
				29 01 00 00 00 00 03 f5 00 00

				29 01 00 00 00 00 02 00 b6
				29 01 00 00 00 00 03 f5 00 00

				29 01 00 00 00 00 02 00 b8
				29 01 00 00 00 00 03 f5 00 00

				29 01 00 00 00 00 02 00 94
				29 01 00 00 00 00 02 f5 02

				29 01 00 00 00 00 02 00 ba
				29 01 00 00 00 00 02 f5 03

				29 01 00 00 00 00 02 00 b4
				29 01 00 00 00 00 02 c5 c0

				29 01 00 00 00 00 02 00 a4  
				29 01 00 00 00 00 02 c0 00  
		
				29 01 00 00 00 00 02 00 87  
				29 01 00 00 00 00 02 c4 18 
				
		//		29 01 00 00 00 00 02 00 80
		//		29 01 00 00 00 00 02 c4 00

				29 01 00 00 00 00 02 00 80
				29 01 00 00 00 00 0c cb 00 00
				00 00 00 00 00 00 00 00 00

				29 01 00 00 00 00 02 00 90
				29 01 00 00 00 00 10 cb 00 00
				00 00 00 00 00 00 00 00 00 00
				00 00 00

				29 01 00 00 00 00 02 00 a0
				29 01 00 00 00 00 10 cb 00 00
				00 00 00 00 00 00 00 00 00 00
				00 00 00

				29 01 00 00 00 00 02 00 b0
				29 01 00 00 00 00 10 cb 00 00
				00 00 00 00 00 00 00 00 00 00
				00 00 00

				29 01 00 00 00 00 02 00 c0
				29 01 00 00 00 00 10 cb 05 05
				05 05 05 05 00 00 00 00 00 00
				00 00 00

				29 01 00 00 00 00 02 00 d0
				29 01 00 00 00 00 10 cb 00 00
				00 00 05 05 05 05 05 05 05 05
				05 00 00

				29 01 00 00 00 00 02 00 e0
				29 01 00 00 00 00 0f cb 00 00
				00 00 00 00 00 00 00 00 00 05
				05 05

				29 01 00 00 00 00 02 00 f0
				29 01 00 00 00 00 0c cb ff cf
				00 03 c0 f0  ff  0c 30 00 0c

				29 01 00 00 00 00 02 00 80
				29 01 00 00 00 00 10 cc 0c 0a
				10 0e 02 04 00 00 00 00 00 00
				00 00 00

				29 01 00 00 00 00 02 00 90
				29 01 00 00 00 00 10 cc 00 00
				00 00 06 2d 2e 0b 09 0f 0d 01
				03 00 00

				29 01 00 00 00 00 02 00 a0
				29 01 00 00 00 00 0f cc 00 00
				00 00 00 00 00 00 00 00 00 05
				2d 2e

				29 01 00 00 00 00 02 00 b0
				29 01 00 00 00 00 10 cc 0d 0f 
				09 0b 03 01 00 00 00 00 00 00
				00 00 00

				29 01 00 00 00 00 02 00 c0
				29 01 00 00 00 00 10 cc 00 00
				00 00 05 2e 2d 0e 10 0a 0c 04
				02 00 00

				29 01 00 00 00 00 02 00 d0
				29 01 00 00 00 00 0f cc 00 00
				00 00 00 00 00 00 00 00 00 06
				2e 2d

				29 01 00 00 00 00 02 00 80
				29 01 00 00 00 00 0d ce 8b 03
				18 8a 03 18 89 03 18 88 03 18

				29 01 00 00 00 00 02 00 90
				29 01 00 00 00 00 0f ce 38 10
				18 38 0f 18 00 00 00 00 00 00
				00 00

				29 01 00 00 00 00 02 00 a0
				29 01 00 00 00 00 0f ce 38 07
				05 00 00 18 00 38 06 05 01 00 
				18 00

				29 01 00 00 00 00 02 00 b0
				29 01 00 00 00 00 0f ce 38 05
				05 02 00 18 00 38 04 05 03 00
				18 00

				29 01 00 00 00 00 02 00 c0
				29 01 00 00 00 00 0f ce 38 03
				05 04 00 18 00 38 02 05 05 00
				18 00

				29 01 00 00 00 00 02 00 d0
				29 01 00 00 00 00 0f ce 38 01
				05 06 00 18 00 38 00 05 07 00
				18 00

				29 01 00 00 00 00 02 00 80
				29 01 00 00 00 00 0f cf 00 00
				00 00 00 00 00 00 00 00 00 00
				00 00 
		
				29 01 00 00 00 00 02 00 90
				29 01 00 00 00 00 0f cf 00 00
				00 00 00 00 00 00 00 00 00 00
				00 00 

				29 01 00 00 00 00 02 00 a0
				29 01 00 00 00 00 0f cf 00 00
				00 00 00 00 00 00 00 00 00 00
				00 00 

				29 01 00 00 00 00 02 00 b0
				29 01 00 00 00 00 0f cf 00 00
				00 00 00 00 00 00 00 00 00 00
				00 00 

				29 01 00 00 00 00 02 00 c0
				29 01 00 00 00 00 0c cf 01 01
				20 20 00 00 01 01 00 00 08

				29 01 00 00 00 00 02 00 b5
				29 01 00 00 00 00 07 c5 38 20
				bf 38 20 bf


				29 01 00 00 00 00 02 00 00
				29 01 00 00 00 00 11 e1 05 0c
				11 0D 06 10 0B 0A 03 07 0B 07
				0E 13 0e 02

				29 01 00 00 00 00 02 00 00
				29 01 00 00 00 00 11 e2 05 0c
				11 0D 06 10 0B 0A 03 07 0B 07
				0E 13 0e 02

				29 01 00 00 00 00 02 00 92
				29 01 00 00 00 00 03 ff 30 02

				//29 01 00 00 00 00 02 00 00
				//29 01 00 00 00 00 02 d9 90

				//cabc start
				29 01 00 00 00 00 02 00 80
				29 01 00 00 00 00 1d ca 01 8e
				95 9d a4 ab b2 ba c1 c8 cf d7
				de e5 ec f4 e8 ff   87 ff 87 ff
				05 03 05 03 05 03

				29 01 00 00 00 00 02 00 00
				29 01 00 00 00 00 02 c6 10
				29 01 00 00 00 00 13 c7 90 a9 
				aa aa aa aa aa aa 99 88 88 88
				77 66 55 55 55 55

				29 01 00 00 00 00 02 00 00
				29 01 00 00 00 00 02 c6 11
				29 01 00 00 00 00 13 c7 90 99
				aa aa aa aa aa 9a 99 88 88 88
				77 66 66 55 55 55

				29 01 00 00 00 00 02 00 00
				29 01 00 00 00 00 02 c6 12
				29 01 00 00 00 00 13 c7 90 99
				a9 aa aa aa aa 99 99 88 88 88
				77 66 66 66 55 55

				29 01 00 00 00 00 02 00 00
				29 01 00 00 00 00 02 c6 13
				29 01 00 00 00 00 13 c7 90 99
				99 aa aa aa 9a 99 99 88 88 88
				77 66 66 66 66 55

				29 01 00 00 00 00 02 00 00
				29 01 00 00 00 00 02 c6 14
				29 01 00 00 00 00 13 c7 90 99
				99 a9 aa aa 99 99 99 88 88 88
				77 66 66 66 66 66

				29 01 00 00 00 00 02 00 00
				29 01 00 00 00 00 02 c6 15
				29 01 00 00 00 00 13 c7 90 99
				99 99 aa 9a 99 99 99 88 88 88
				77 77 66 66 66 66

				29 01 00 00 00 00 02 00 00
				29 01 00 00 00 00 02 c6 16
				29 01 00 00 00 00 13 c7 90 99
				99 99 a9 99 99 99 99 88 88 88
				77 77 77 66 66 66

				29 01 00 00 00 00 02 00 00
				29 01 00 00 00 00 02 c6 17
				29 01 00 00 00 00 13 c7 80 99
				99 99 99 99 99 99 99 88 88 88
				77 77 77 77 66 66

				29 01 00 00 00 00 02 00 00
				29 01 00 00 00 00 02 c6 18
				29 01 00 00 00 00 13 c7 80 98
				99 99 99 98 99 99 99 88 88 88
				77 77 77 77 77 66

				29 01 00 00 00 00 02 00 00
				29 01 00 00 00 00 02 c6 19
				29 01 00 00 00 00 13 c7 80 88
				99 99 99 88 99 99 99 88 88 88
				77 77 77 77 77 77

				29 01 00 00 00 00 02 00 00
				29 01 00 00 00 00 02 c6 1a
				29 01 00 00 00 00 13 c7 80 88 
				98 99 99 88 98 99 99 88 88 88
				88 77 77 77 77 77

				29 01 00 00 00 00 02 00 00
				29 01 00 00 00 00 02 c6 1b
				29 01 00 00 00 00 13 c7 80 88
				88 99 99 88 88 99 99 88 88 88
				88 88 77 77 77 77

				29 01 00 00 00 00 02 00 00
				29 01 00 00 00 00 02 c6 1c
				29 01 00 00 00 00 13 c7 80 88
				88 98 99 88 88 98 99 88 88 88
				88 88 88 77 77 77

				29 01 00 00 00 00 02 00 00
				29 01 00 00 00 00 02 c6 1d
				29 01 00 00 00 00 13 c7 80 88
				88 88 99 88 88 88 99 88 88 88
				88 88 88 88 77 77

				29 01 00 00 00 00 02 00 00
				29 01 00 00 00 00 02 c6 1e
				29 01 00 00 00 00 13 c7 80 88
				88 88 98 88 88 88 98 88 88 88
				88 88 88 88 78 78

				29 01 00 00 00 00 02 00 00
				29 01 00 00 00 00 02 c6 1f
				29 01 00 00 00 00 13 c7 80 88 
				88 88 88 88 88 88 88 88 88 88
				88 88 88 88 88 88
				
				29 01 00 00 00 00 02 00 00
				29 01 00 00 00 00 02 c6 00
				//cabc end
				
				//CE start
				29 01 00 00 00 00 02 00 a0
				29 01 00 00 00 00 0d d6 01 00
				01 00 01 00 01 f3 01 f3 01 f3

				29 01 00 00 00 00 02 00 b0
				29 01 00 00 00 00 0d d6 01 f3
				01 f3 01 f3 01 f3 01 f3 01 f3

				29 01 00 00 00 00 02 00 c0
				29 01 00 00 00 00 0d d6 37 11
				00 a2 11 a2 a2 11 a2 a2 01 a2

				29 01 00 00 00 00 02 00 d0
				29 01 00 00 00 00 06 d6 11 a2
				a2 11 a2



				29 01 00 00 00 00 02 00 e0
				29 01 00 00 00 00 0d d6 37 11
				51 51 11 51 51 11 51 51 11 51


				
				29 01 00 00 00 00 02 00 f0
				29 01 00 00 00 00 07 d6 51 11
				51 51 11 51

				29 01 00 00 00 00 02 00 90
				29 01 00 00 00 00 02 d6 80

				29 01 00 00 00 00 02 00 80
				29 01 00 00 00 00 02 d6 08
				
				29 01 00 00 00 00 02 00 b1
				29 01 00 00 00 00 02 c6 00
				
			//	29 01 00 00 00 00 02 00 b3
			//	29 01 00 00 00 00 02 c6 4a
			
				29 01 00 00 00 00 02 00 b4
				29 01 00 00 00 00 02 c6 16
				//29 01 00 00 00 00 02 00 81
				//29 01 00 00 00 00 03 d6 09 ff

				//CE end
				//29 01 00 00 00 00 02 00 00
				//29 01 00 00 00 00 04 ff ff ff
				//ff
				05 01 00 00 78 00 02 11 00
				05 01 00 00 14 00 02 29 00
				
				15 01 00 00 00 00 02  35  00
			//	15 01 00 00 00 00 02  51  00
				15 01 00 00 00 00 02  55  01
			//	15 01 00 00 00 00 02  53  24			

				];
		qcom,mdss-dsi-off-command = [05 01 00 00 0a 00 02 28 00
				05 01 00 00 96 00 02 10 00];
		qcom,mdss-dsi-on-command-state = "dsi_lp_mode";
		qcom,mdss-dsi-off-command-state = "dsi_hs_mode";
		qcom,mdss-dsi-h-sync-pulse = <1>;
		qcom,mdss-dsi-traffic-mode = "non_burst_sync_pulse";
		qcom,mdss-dsi-lane-map = <0>;
		qcom,mdss-dsi-bllp-eof-power-mode;
		qcom,mdss-dsi-bllp-power-mode;
		qcom,mdss-dsi-lane-0-state;
		qcom,mdss-dsi-lane-1-state;
		qcom,mdss-dsi-lane-2-state;
		qcom,mdss-dsi-lane-3-state;
		qcom,mdss-dsi-panel-timings = [8d 24 19 00 34 34 1d 26 2a 03 04 00];
		qcom,mdss-dsi-t-clk-post = <0x1f>;
		qcom,mdss-dsi-t-clk-pre = <0x2d>;
		qcom,mdss-dsi-bl-min-level = <1>;
		qcom,mdss-dsi-bl-max-level = <255>;
		qcom,mdss-dsi-dma-trigger = "trigger_sw";
		qcom,mdss-dsi-mdp-trigger = "none";
		qcom,mdss-dsi-bl-pmic-control-type = "bl_ctrl_dcs";
		qcom,mdss-dsi-pan-enable-dynamic-fps;
		qcom,mdss-dsi-pan-fps-update = "dfps_suspend_resume_mode";
		qcom,mdss-dsi-reset-sequence = <1 5>, <0 5>, <1 5>;
	};
};
