/* Copyright (c) 2012-2013, The Linux Foundation. All rights reserved.
 *
 * This program is free software; you can redistribute it and/or modify
 * it under the terms of the GNU General Public License version 2 and
 * only version 2 as published by the Free Software Foundation.
 *
 * This program is distributed in the hope that it will be useful,
 * but WITHOUT ANY WARRANTY; without even the implied warranty of
 * MERCHANTABILITY or FITNESS FOR A PARTICULAR PURPOSE.  See the
 * GNU General Public License for more details.
 */

/*---------------------------------------------------------------------------
 * This file is autogenerated file using gcdb parser. Please do not edit it.
 * Update input XML file to add a new entry or update variable in this file
 * VERSION = "1.0"
 *---------------------------------------------------------------------------*/
&mdss_mdp {
	dsi_yassy_720_vid: qcom,mdss_dsi_yassy_720p_video {
		qcom,mdss-dsi-panel-name = "yassy 720p video mode dsi panel";
		qcom,mdss-dsi-panel-controller = <&mdss_dsi0>;
		qcom,mdss-dsi-panel-type = "dsi_video_mode";
		qcom,mdss-dsi-panel-destination = "display_1";
		qcom,mdss-dsi-panel-framerate = <60>;
		qcom,mdss-dsi-virtual-channel-id = <0>;
		qcom,mdss-dsi-stream = <0>;
		qcom,mdss-dsi-panel-width = <720>;
		qcom,mdss-dsi-panel-height = <1280>;
		qcom,mdss-dsi-h-front-porch = <79>;
		qcom,mdss-dsi-h-back-porch = <59>;
		qcom,mdss-dsi-h-pulse-width = <60>;
		qcom,mdss-dsi-h-sync-skew = <0>;
		qcom,mdss-dsi-v-back-porch = <14>;
		qcom,mdss-dsi-v-front-porch = <50>;
		qcom,mdss-dsi-v-pulse-width = <2>;
		qcom,mdss-dsi-h-left-border = <0>;
		qcom,mdss-dsi-h-right-border = <0>;
		qcom,mdss-dsi-v-top-border = <0>;
		qcom,mdss-dsi-v-bottom-border = <0>;
		qcom,mdss-dsi-bpp = <24>;
		qcom,mdss-dsi-color-order = "rgb_swap_rgb";
		qcom,mdss-dsi-underflow-color = <0xff>;
		qcom,mdss-dsi-border-color = <0>;
		qcom,mdss-dsi-on-command = [
				39 01 00 00 00 00 04 b9 ff 83 94
				15 01 00 00 00 00 02 BA 13
					
				39 01 00 00 00 00 14 B1 01 00 04
				c4 03 12 f1 24 2c 3f 3f 57 02 00
				e6 E2 a6 00 00
				
				39 01 00 00 00 00 07 B2 00 C8 0e
				30 00 33
			
				39 01 00 00 00 00 20 B4 80 04 32
				10 08 54 15 0f 32 10 08 47 53 54
				0a 4b 53 54 02 61 61 02 06 44 06
				5f 0a 6b 70 05 08
				
				15 01 00 00 00 00 02  b6  3f
				
				39 01 00 00 00 00 38 D5 00 00 00
				00 0A 00 01 22 00 33 cc 00 aa bb
				01 23 45 67 9a bc 45 67 88 88 88
				88 88 88 88 01 88 88 88 88 88 88
				88 88 88 88 88 88 88 88 88 88 88
				88 88 88 88 88 3C 01 00
				
				15 01 00 00 00 00 02 CC 09
				
				39 01 00 00 00 00 05 C7 00 10 00
				10

				39 01 00 00 00 00 2C E0 00 00 03
				27 2e 3F 12 34 06 0B 0f 12 14 13
				14 11 17 00 01 04 27 2d 3F 11 34
				05 0B 10 12 15 12 13 10 19 09 16
				07 12 09 17 06 12 00

				39 01 00 00 00 00 03 c0 0c 17
				39 01 00 00 00 00 03 c6 08 08

				39 01 00 00 00 00 03 c9 0f 00
				
				15 01 00 00 00 00 02 D4 32
				15 01 00 00 00 00 02 36 04
				
				15 01 00 00 00 00 02 35 00

				15 01 00 00 00 00 02 53 24
				15 01 00 00 00 00 02 55 03
				
				05 01 00 00 78 00 02 11 00
				05 01 00 00 14 00 02 29 00];
		qcom,mdss-dsi-off-command = [05 01 00 00 0a 00 02 28 00
				05 01 00 00 96 00 02 10 00];
		qcom,mdss-dsi-on-command-state = "dsi_lp_mode";
		qcom,mdss-dsi-off-command-state = "dsi_hs_mode";
		qcom,mdss-dsi-h-sync-pulse = <1>;
		qcom,mdss-dsi-traffic-mode = "burst_mode";
		qcom,mdss-dsi-lane-map = <0>;
		qcom,mdss-dsi-bllp-eof-power-mode;
		qcom,mdss-dsi-bllp-power-mode;
		qcom,mdss-dsi-lane-0-state;
		qcom,mdss-dsi-lane-1-state;
		qcom,mdss-dsi-lane-2-state;
		qcom,mdss-dsi-lane-3-state;
		qcom,mdss-dsi-panel-timings = [8d 24 19 00 34 34 1d 26 2a 03 04 00];
		qcom,mdss-dsi-t-clk-post = <0x1f>;
		qcom,mdss-dsi-t-clk-pre = <0x2d>;
		qcom,mdss-dsi-bl-min-level = <1>;
		qcom,mdss-dsi-bl-max-level = <255>;
		qcom,mdss-dsi-dma-trigger = "trigger_sw";
		qcom,mdss-dsi-mdp-trigger = "none";
		qcom,mdss-dsi-bl-pmic-control-type = "bl_ctrl_dcs";
		qcom,mdss-dsi-pan-enable-dynamic-fps;
		qcom,mdss-dsi-pan-fps-update = "dfps_suspend_resume_mode";
		qcom,mdss-dsi-reset-sequence = <1 2>, <1 1>, <1 1>;
	};
};
