/* Copyright (c) 2012-2013, The Linux Foundation. All rights reserved.
 *
 * This program is free software; you can redistribute it and/or modify
 * it under the terms of the GNU General Public License version 2 and
 * only version 2 as published by the Free Software Foundation.
 *
 * This program is distributed in the hope that it will be useful,
 * but WITHOUT ANY WARRANTY; without even the implied warranty of
 * MERCHANTABILITY or FITNESS FOR A PARTICULAR PURPOSE.  See the
 * GNU General Public License for more details.
 */

/*---------------------------------------------------------------------------
 * This file is autogenerated file using gcdb parser. Please do not edit it.
 * Update input XML file to add a new entry or update variable in this file
 * VERSION = "1.0"
 *---------------------------------------------------------------------------*/
&mdss_mdp {
	dsi_tianma_720_vid: qcom,mdss_dsi_tianma_720p_video {
		qcom,mdss-dsi-panel-name = "tianma 720p video mode dsi panel";
		qcom,mdss-dsi-panel-controller = <&mdss_dsi0>;
		qcom,mdss-dsi-panel-type = "dsi_video_mode";
		qcom,mdss-dsi-panel-destination = "display_1";
		qcom,mdss-dsi-panel-framerate = <60>;
		qcom,mdss-dsi-virtual-channel-id = <0>;
		qcom,mdss-dsi-stream = <0>;
		qcom,mdss-dsi-panel-width = <720>;
		qcom,mdss-dsi-panel-height = <1280>;
		qcom,mdss-dsi-h-front-porch = <79>;
		qcom,mdss-dsi-h-back-porch = <59>;
		qcom,mdss-dsi-h-pulse-width = <60>;
		qcom,mdss-dsi-h-sync-skew = <0>;
		qcom,mdss-dsi-v-back-porch = <10>;
		qcom,mdss-dsi-v-front-porch = <7>;
		qcom,mdss-dsi-v-pulse-width = <2>;
		qcom,mdss-dsi-h-left-border = <0>;
		qcom,mdss-dsi-h-right-border = <0>;
		qcom,mdss-dsi-v-top-border = <0>;
		qcom,mdss-dsi-v-bottom-border = <0>;
		qcom,mdss-dsi-bpp = <24>;
		qcom,mdss-dsi-color-order = <0>;
		qcom,mdss-dsi-underflow-color = <0xff>;
		qcom,mdss-dsi-border-color = <0>;
		qcom,mdss-dsi-on-command = [
				39 01 00 00 00 00 04 b9 ff 83 94
				39 01 00 00 00 00 11 BA 13 82
				00 16 C5 00 10 ff  0f 24  03 21
				24 25 20 08
					
				39 01 00 00 00 00 80 c1 01 00
				08 10 18 1F 28 2f 36 3F 47 4F
				57 5F 67 6F 76 7E 86 8E 96 9E
				A6 AE B6 BE C6 CE D6 DE E6 EE
				F8 FF 00 00 00  00 00 00 00 00
				00 00 08 10 18  21 29 31 37 40
				48 51 58 60 67  70 76 7E 86	 8E
				96 9E A6 AE B6  BE C6 CE D6 DE
				E6 EE F8 FF 00  00 00 00  00 00
				00 00 00 00 08  10 18 1F  28 30
				37 40 48 51 59  61 69 72  79 81
				89 92 9A A2 AB  B3 BB C3 CC D3
				DB E3 EB F1 F8 FF 00 00  00 00
				00 00 00 00 00
				
				39 01 00 00 00 00 10 b1 01 00
				07 87 01 11 11 22 2a 3f 3f 57
				02 00 e6
				
				15 01 00 00 00 00 02 b2 00
				39 01 00 00 00 00 05 bf 06 00 10 04
				
				39 01 00 00 00 00 17 b4 80 08
				32 10 0d 32 10 08 22 10 08 37
				04 4a 11 37 04 44 06 5a 5a 06
				
				39 01 00 00 00 00 35 d5 00 00
				00 10 0a 00 01 33 00 00 33 00
				23 01 67 45 01 23 88 88 88 88
				88 88 88 88 88 88 88 45 88 99
				54 76 10 32 32 10 88 88 88 88
				88 88 88 88 88 88 88 54 99 88

				39 01 00 00 00 00 05 c7 00 10
				00 10

				39 01 00 00 00 00 2b e0 00 0a
				13 33 38 3f 23 44	06 0c 0f 13
				16 14 15 10 17 00 0a 13 33 38
				3f 23 44 06 0c 0f 13 16 14 15
				10 17 09 17 08 18 09 17 08 18

				39 01 00 00 00 00 03 c0 0c 17
				15 01 00 00 00 00 02 cc 09
				15 01 00 00 00 00 02 b6 22

				15 01 00 00 00 00 02  55  03
				15 01 00 00 00 00 02  53  2c
				
				05 01 00 00 78 00 02 11 00
				05 01 00 00 14 00 02 29 00];
		qcom,mdss-dsi-off-command = [05 01 00 00 0a 00 02 28 00
				05 01 00 00 96 00 02 10 00];
		qcom,mdss-dsi-on-command-state = "dsi_lp_mode";
		qcom,mdss-dsi-off-command-state = "dsi_hs_mode";
		qcom,mdss-dsi-h-sync-pulse = <1>;
		qcom,mdss-dsi-traffic-mode = <2>;
		qcom,mdss-dsi-lane-map = <0>;
		qcom,mdss-dsi-bllp-eof-power-mode;
		qcom,mdss-dsi-bllp-power-mode;
		qcom,mdss-dsi-lane-0-state;
		qcom,mdss-dsi-lane-1-state;
		qcom,mdss-dsi-lane-2-state;
		qcom,mdss-dsi-lane-3-state;
		qcom,mdss-dsi-panel-timings = [8d 24 19 00 34 34 1d 26 2a 03 04 00];
		qcom,mdss-dsi-t-clk-post = <0x1f>;
		qcom,mdss-dsi-t-clk-pre = <0x2d>;
		qcom,mdss-dsi-bl-min-level = <1>;
		qcom,mdss-dsi-bl-max-level = <255>;
		qcom,mdss-dsi-dma-trigger = <0x04>;
		qcom,mdss-dsi-mdp-trigger = <0x0>;
		qcom,mdss-dsi-bl-pmic-control-type = "bl_ctrl_dcs";
		qcom,mdss-dsi-pan-enable-dynamic-fps;
		qcom,mdss-dsi-pan-fps-update = "dfps_suspend_resume_mode";
		qcom,mdss-dsi-reset-sequence = <1 20>, <0 5>, <1 20>;
	};
};
