/* Copyright (c) 2012-2013, The Linux Foundation. All rights reserved.
 *
 * This program is free software; you can redistribute it and/or modify
 * it under the terms of the GNU General Public License version 2 and
 * only version 2 as published by the Free Software Foundation.
 *
 * This program is distributed in the hope that it will be useful,
 * but WITHOUT ANY WARRANTY; without even the implied warranty of
 * MERCHANTABILITY or FITNESS FOR A PARTICULAR PURPOSE.  See the
 * GNU General Public License for more details.
 */

/*---------------------------------------------------------------------------
 * This file is autogenerated file using gcdb parser. Please do not edit it.
 * Update input XML file to add a new entry or update variable in this file
 * VERSION = "1.0"
 *---------------------------------------------------------------------------*/
&mdss_mdp {
	dsi_boe_720_vid: qcom,mdss_dsi_boe_otm1284_720p_video {
		qcom,mdss-dsi-panel-name = "boe otm1284 720p video mode dsi panel";
		qcom,mdss-dsi-panel-controller = <&mdss_dsi0>;
		qcom,mdss-dsi-panel-type = "dsi_video_mode";
		qcom,mdss-dsi-panel-destination = "display_1";
		qcom,mdss-dsi-panel-framerate = <60>;
		qcom,mdss-dsi-virtual-channel-id = <0>;
		qcom,mdss-dsi-stream = <0>;
		qcom,mdss-dsi-panel-width = <720>;
		qcom,mdss-dsi-panel-height = <1280>;
		qcom,mdss-dsi-h-front-porch = <79>;
		qcom,mdss-dsi-h-back-porch = <59>;
		qcom,mdss-dsi-h-pulse-width = <60>;
		qcom,mdss-dsi-h-sync-skew = <0>;
		qcom,mdss-dsi-v-back-porch = <14>;
		qcom,mdss-dsi-v-front-porch = <16>;
		qcom,mdss-dsi-v-pulse-width = <2>;
		qcom,mdss-dsi-h-left-border = <0>;
		qcom,mdss-dsi-h-right-border = <0>;
		qcom,mdss-dsi-v-top-border = <0>;
		qcom,mdss-dsi-v-bottom-border = <0>;
		qcom,mdss-dsi-bpp = <24>;
		qcom,mdss-dsi-color-order = "rgb_swap_rgb";
		qcom,mdss-dsi-underflow-color = <0x0>;
		qcom,mdss-dsi-border-color = <0>;
		qcom,mdss-dsi-on-command = [
			29 01 00 00 00 00 02 00 00
			29 01 00 00 00 00 04 FF 12 83
			01
			
			29 01 00 00 00 00 02 00 80
			
			29 01 00 00 00 00 03 FF 12 83

		//	29 01 00 00 00 00 02 00 91
			 
		//	29 01 00 00 00 00 02 B0 9A
			
			29 01 00 00 00 00 02 00 92

			29 01 00 00 00 00 03 FF 30 02

			29 01 00 00 00 00 02 00 80

			29 01 00 00 00 00 0a C0 00 64
			00 0F 11 00 64 0F 11
			29 01 00 00 00 00 02 00 90
			29 01 00 00 00 00 07 C0 00 55
			00 01 00 04

			29 01 00 00 00 00 02 00 A4
			29 01 00 00 00 00 02 C0 00
			29 01 00 00 00 00 02 00 B3
			29 01 00 00 00 00 03 C0 00 50
			29 01 00 00 00 00 02 00 81
			29 01 00 00 00 00 02 C1 66

			29 01 00 00 00 00 02 00 90
			 
			29 01 00 00 00 00 02 c4 49
			29 01 00 00 00 00 02 00 90
			 
			29 01 00 00 00 00 05 f5 02
			11 02 11
			29 01 00 00 00 00 02 00 90
			 
			29 01 00 00 00 00 02 c5 50
			29 01 00 00 00 00 02 00 94
			 
			29 01 00 00 00 00 02 c5 66
			
			29 01 00 00 00 00 02 00 B2
			29 01 00 00 00 00 03 F5 00 00
			29 01 00 00 00 00 02 00 B4
			29 01 00 00 00 00 03 F5 00 00
			29 01 00 00 00 00 02 00 B6
			29 01 00 00 00 00 03 F5 00 00
			29 01 00 00 00 00 02 00 B8
			29 01 00 00 00 00 03 F5 00 00
			29 01 00 00 00 00 02 00 94
			 
			29 01 00 00 00 00 02 f5 02

			29 01 00 00 00 00 02 00 ba
			29 01 00 00 00 00 02 f5 03
			
			29 01 00 00 00 00 02 00 B4
			29 01 00 00 00 00 02 C5 C0
			29 01 00 00 00 00 02 00 A0
			29 01 00 00 00 00 0F C4 05 10
			06 02 05 15 10 05 10 07 02 05
			15 10
			29 01 00 00 00 00 02 00 B0
			29 01 00 00 00 00 03 C4 00 00
			29 01 00 00 00 00 02 00 91
			29 01 00 00 00 00 03 C5 19 50
			29 01 00 00 00 00 02 00 00
			
			29 01 00 00 00 00 03 D8 A5 A5
		//	29 01 00 00 00 00 02 00 B3
		//	29 01 00 00 00 00 02 C5 84
			29 01 00 00 00 00 02 00 b0
			29 01 00 00 00 00 03 C5 04 b8
			
			29 01 00 00 00 00 02 00 BB
			29 01 00 00 00 00 02 C5 80
			29 01 00 00 00 00 02 00 B2
			29 01 00 00 00 00 02 C5 40
			29 01 00 00 00 00 02 00 00
			29 01 00 00 00 00 02 d0 40
			29 01 00 00 00 00 02 00 00
			29 01 00 00 00 00 03 d1 00 00		
			29 01 00 00 00 00 02 00 81
			29 01 00 00 00 00 03 C4 84 02
			29 01 00 00 00 00 02 00 C6
			29 01 00 00 00 00 02 B0 03
			29 01 00 00 00 00 02 00 00
			29 01 00 00 00 00 11 E1 08 0F
			15 0d 06 11 0c 0b 02 06 0a 07
			0f 11 0D 00

			29 01 00 00 00 00 02 00 00
			29 01 00 00 00 00  11 E2 08 0F
			15 0d 06 11 0c 0b 02 06 0a 07
			0f 11 0D 00

			29 01 00 00 00 00 02 00 80
			29 01 00 00 00 00 0C CB 00 00
			00 00 00 00 00 00 00 00 00
			29 01 00 00 00 00 02 00 90
			29 01 00 00 00 00 10 CB 00 00
			00 00 00 00 00 00 00 00 00 00
			00 00 00
			29 01 00 00 00 00 02 00 A0
			29 01 00 00 00 00 10 CB 00 00
			00 00 00 00 00 00 00 00 00 00
			00 00 00
			29 01 00 00 00 00 02 00 B0
			29 01 00 00 00 00 10 CB 00 00
			00 00 00 00 00 00 00 00 00 00
			00 00 00
			29 01 00 00 00 00 02 00 C0
			29 01 00 00 00 00 10 CB 05 05
			05 05 05 05 00 00 00 00 00 00
			00 00 00
			29 01 00 00 00 00 02 00 D0
			29 01 00 00 00 00 10 CB 00 00
			00 00 00 05 05 05 05 05 05 05
			05 00 00
			29 01 00 00 00 00 02 00 E0
			29 01 00 00 00 00 0F CB 00 00
			00 00 00 00 00 00 00 00 00 00
			05 05
			
			29 01 00 00 00 00 02 00 F0
			29 01 00 00 00 00 0C CB FF FF
			FF FF FF FF FF FF FF FF FF
			29 01 00 00 00 00 02 00 80
			29 01 00 00 00 00 10 CC 09 0B
			0D 0F 01 03 00 00 00 00 00 00
			00 00 00
			29 01 00 00 00 00 02 00 90
			29 01 00 00 00 00 10 CC 00 00
			00 00 00 2E 2D 0A 0C 0E 10 02 04 00 00
			
			29 01 00 00 00 00 02 00 A0
			29 01 00 00 00 00 0F CC 00 00
			00 00 00 00 00 00 00 00 00 00 2E 2D

			29 01 00 00 00 00 02 00 B0
			29 01 00 00 00 00 10 CC 10 0E
			0C 0A 04 02 00 00 00 00 00 00 00 00 00

			29 01 00 00 00 00 02 00 C0
			29 01 00 00 00 00 10 CC 00 00
			00 00 00 2D 2E 0F 0D 0B 09 03 01 00 00

			29 01 00 00 00 00 02 00 D0
			29 01 00 00 00 00 0F CC 00 00
			00 00 00 00 00 00 00 00 00 00 2D 2E

			29 01 00 00 00 00 02 00 80
			29 01 00 00 00 00 0D CE 8b 03
			00 8a 03 00 89 03 00 88 03 00

			29 01 00 00 00 00 02 00 90
			29 01 00 00 00 00 0F CE 00 00
			00 00 00 00 00 00 00 00 00 00 00 00

			29 01 00 00 00 00 02 00 A0
			29 01 00 00 00 00 0F CE 38 07
			84 FC 8b 04 00 38 06 84 FD 8b 04 00

			29 01 00 00 00 00 02 00 B0
			29 01 00 00 00 00 0F CE 38 05
			84 FE 8b 04 00 38 04 84 FF 8b 04 00

			29 01 00 00 00 00 02 00 C0
			29 01 00 00 00 00 0F CE 38 03
			85 00 8b 04 00 38 02 85 01 8b 04 00
			
			29 01 00 00 00 00 02 00 D0
			29 01 00 00 00 00 0F CE 38 01
			85 02 8b 04 00 38 00 85 03 8b 04 00
			
			29 01 00 00 00 00 02 00 80
			29 01 00 00 00 00 0F CF 00 00
			00 00 00 00 00 00 00 00 00 00 00 00
			
			29 01 00 00 00 00 02 00 90
			29 01 00 00 00 00 0F CF 00 00
			00 00 00 00 00 00 00 00 00 00 00 00

			29 01 00 00 00 00 02 00 A0
			29 01 00 00 00 00 0F CF 00 00
			00 00 00 00 00 00 00 00 00 00 00 00

			29 01 00 00 00 00 02 00 B0
			29 01 00 00 00 00 0F CF 00 00
			00 00 00 00 00 00 00 00 00 00 00 00

			29 01 00 00 00 00 02 00 C0
			29 01 00 00 00 00 0C CF 01 01
			20 20 00 00 01 01 00 02 02

			29 01 00 00 00 00 02 00 B5
			29 01 00 00 00 00 07 C5 33 F1
			FF 33 F1 FF
			29 01 00 00 00 00 02 00 87
			29 01 00 00 00 00 02 c4 08
			29 01 00 00 00 00 02 00 89
			29 01 00 00 00 00 02 c4 08
			
			29 01 00 00 00 00 02 00 80
			29 01 00 00 00 00 02 c4 01
			
			29 01 00 00 00 00 02 00 88
			29 01 00 00 00 00 02 c4 80
			
			29 01 00 00 00 00 02 00 c2
			29 01 00 00 00 00 02 f5 c0
			
			29 01 00 00 00 00 02 00 A0                     
			29 01 00 00 00 00 0D D6 01 1A 01 1A 01
			E6 01 B3 01 B3 01 B3
			29 01 00 00 00 00 02 00 B0                     
			29 01 00 00 00 00 0D D6 01 B3 01 CD 01
			cd 01 cd 01 cd 01 66	
			29 01 00 00 00 00 02 00 C0                     
			29 01 00 00 00 00 0D D6 66 11 11 9A 11
			77 77 11 77 77 11 89
			29 01 00 00 00 00 02 00 D0                     
			29 01 00 00 00 00 07 D6 89 11 89 89 11
			44
			29 01 00 00 00 00 02 00 E0                     
			29 01 00 00 00 00 0D D6 33 11 44 4D 11
			3C 3C 11 3C 3C 11 44
			29 01 00 00 00 00 02 00 F0                     
			29 01 00 00 00 00 07 D6 44 11 44 44 11
			22
			
			29 01 00 00 00 00 02 00 90
			29 01 00 00 00 00 02 d6 00		
			
			29 01 00 00 00 00 02 00 00
			29 01 00 00 00 00 04 FF FF FF
			FF
			29 01 00 00 00 00 02 00 00
			29 01 00 00 00 00 02 36 00
			29 01 00 00 00 00 02 35 00
			29 01 00 00 00 00 02 53 2C
			29 01 00 00 00 00 02 55 03

			29 01 00 00 78 00 02 11 00
			29 01 00 00 14 00 02 29 00
		];
		qcom,mdss-dsi-off-command = [05 01 00 00 0a 00 02 28 00
				05 01 00 00 00 00 02 10 00];
		qcom,mdss-dsi-on-command-state = "dsi_lp_mode";
		qcom,mdss-dsi-off-command-state = "dsi_hs_mode";
		qcom,mdss-dsi-h-sync-pulse = <1>;
		qcom,mdss-dsi-traffic-mode = "burst_mode";
		qcom,mdss-dsi-lane-map = <0>;
		qcom,mdss-dsi-bllp-eof-power-mode;
		qcom,mdss-dsi-bllp-power-mode;
		qcom,mdss-dsi-lane-0-state;
		qcom,mdss-dsi-lane-1-state;
		qcom,mdss-dsi-lane-2-state;
		qcom,mdss-dsi-lane-3-state;
		qcom,mdss-dsi-panel-timings = [8d 24 19 00 34 34 1d 26 2a 03 04 00];
		qcom,mdss-dsi-t-clk-post = <0x1f>;
		qcom,mdss-dsi-t-clk-pre = <0x2d>;
		qcom,mdss-dsi-bl-min-level = <1>;
		qcom,mdss-dsi-bl-max-level = <255>;
		qcom,mdss-dsi-dma-trigger = "trigger_sw";
		qcom,mdss-dsi-mdp-trigger = "none";
		qcom,mdss-dsi-bl-pmic-control-type = "bl_ctrl_dcs";
		qcom,mdss-dsi-pan-enable-dynamic-fps;
		qcom,mdss-dsi-pan-fps-update = "dfps_suspend_resume_mode";
		qcom,mdss-dsi-reset-sequence = <1 5>, <0 5>, <1 5>;
	};
};
