/* Copyright (c) 2013, The Linux Foundation. All rights reserved.
 *
 * This program is free software; you can redistribute it and/or modify
 * it under the terms of the GNU General Public License version 2 and
 * only version 2 as published by the Free Software Foundation.
 *
 * This program is distributed in the hope that it will be useful,
 * but WITHOUT ANY WARRANTY; without even the implied warranty of
 * MERCHANTABILITY or FITNESS FOR A PARTICULAR PURPOSE.  See the
 * GNU General Public License for more details.
 */

/*---------------------------------------------------------------------------
 * This file is autogenerated file using gcdb parser. Please do not edit it.
 * Update input XML file to add a new entry or update variable in this file
 * VERSION = "1.0"
 *---------------------------------------------------------------------------*/
&mdss_mdp {
	dsi_yushun_nt35521_720_vid: qcom,mdss_dsi_yushun_nt35521_720p_video {
		qcom,mdss-dsi-panel-name = "yushun nt35521 720p video mode dsi panel";
		qcom,mdss-dsi-panel-controller = <&mdss_dsi0>;
		qcom,mdss-dsi-panel-type = "dsi_video_mode";
		qcom,mdss-dsi-panel-destination = "display_1";
		qcom,mdss-dsi-panel-framerate = <60>;
		qcom,mdss-dsi-virtual-channel-id = <0>;
		qcom,mdss-dsi-stream = <0>;
		qcom,mdss-dsi-panel-width = <720>;
		qcom,mdss-dsi-panel-height = <1280>;
		qcom,mdss-dsi-h-front-porch = <79>;
		qcom,mdss-dsi-h-back-porch = <59>;
		qcom,mdss-dsi-h-pulse-width = <60>;
		qcom,mdss-dsi-h-sync-skew = <0>;
		qcom,mdss-dsi-v-back-porch = <14>;
		qcom,mdss-dsi-v-front-porch = <16>;
		qcom,mdss-dsi-v-pulse-width = <2>;
		qcom,mdss-dsi-h-left-border = <0>;
		qcom,mdss-dsi-h-right-border = <0>;
		qcom,mdss-dsi-v-top-border = <0>;
		qcom,mdss-dsi-v-bottom-border = <0>;
		qcom,mdss-dsi-bpp = <24>;
		qcom,mdss-dsi-color-order = "rgb_swap_rgb";
		qcom,mdss-dsi-underflow-color = <0x0>;
		qcom,mdss-dsi-border-color = <0>;
		
		qcom,mdss-dsi-on-command = [29 01 00 00 00 00 06 F0 55 AA 52 08 00
				29 01 00 00 00 00 05 FF AA 55 A5 80
				29 01 00 00 00 00 03 B1 68 21
				
				29 01 00 00 00 00 06 BD 01 a3 20 10 01
				29 01 00 00 00 00 02 6f 02
				29 01 00 00 00 00 02 b8 08

				29 01 00 00 00 00 03 bb 11 11
				29 01 00 00 00 00 03 bc 00 00

				29 01 00 00 00 00 02 b6 01
				29 01 00 00 00 00 02 c8 83

				29 01 00 00 00 00 06 F0 55 AA 52 08 01
				29 01 00 00 00 00 03 b0 0f 0f
				29 01 00 00 00 00 03 b1 0f 0f
				29 01 00 00 00 00 02 ce 66

				29 01 00 00 00 00 02 c0 0c
				29 01 00 00 00 00 03 b5 05 05

				29 01 00 00 00 00 02 be 45
				29 01 00 00 00 00 03 b3 28 28
				29 01 00 00 00 00 03 b4 19 19
				29 01 00 00 00 00 03 b9 34 34
				29 01 00 00 00 00 03 ba 24 24

				29 01 00 00 00 00 03 bc 70 00
				29 01 00 00 00 00 03 bd 70 00

				29 01 00 00 00 00 02 ca 00
				29 01 00 00 00 00 06 f0 55 aa 52 08 02
				29 01 00 00 00 00 02 ee 01
				29 01 00 00 00 00 11 B0 00 12 00 4B 00 7F 00 A0 00 BA 00 E2 01 02 01 33
				29 01 00 00 00 00 11 B1 01 59 01 95 01 C4 02 0B 02 44 02 46 02 7C 02 B7
				29 01 00 00 00 00 11 B2 02 D9 03 05 03 22 03 44 03 55 03 65 03 6B 03 6F

				29 01 00 00 00 00 05 B3 03 71 03 72
				
				29 01 00 00 00 00 02 6f 02
				29 01 00 00 00 00 02 f8 44
				29 01 00 00 00 00 02 6f 0f
				29 01 00 00 00 00 02 fa 14
				29 01 00 00 00 00 02 6f 02
				29 01 00 00 00 00 02 f7 ef
				29 01 00 00 00 00 02 6f 0a
				29 01 00 00 00 00 02 f7 02
				29 01 00 00 00 00 02 6f 0c
				29 01 00 00 00 00 02 f4 d8
				29 01 00 00 00 00 02 6f 0e
				29 01 00 00 00 00 02 f4 44
				29 01 00 00 00 00 02 6f 17
				29 01 00 00 00 00 02 f4 60
				29 01 00 00 00 00 02 6f 01
				29 01 00 00 00 00 02 f9 46

				29 01 00 00 00 00 06 F0 55
				AA 52 08 06 
				29 01 00 00 00 00 03 b0 2e 2e
				29 01 00 00 00 00 03 b1 2e 2e
				29 01 00 00 00 00 03 b2 2e 2e
				29 01 00 00 00 00 03 b3 2e 09
				29 01 00 00 00 00 03 b4 0b 11
				29 01 00 00 00 00 03 b5 17 19
				29 01 00 00 00 00 03 b6 23 1d
				29 01 00 00 00 00 03 b7 25 1f
				29 01 00 00 00 00 03 b8 01 03
				29 01 00 00 00 00 03 b9 2e 2e
				29 01 00 00 00 00 03 ba 2e 2e
				29 01 00 00 00 00 03 bb 02 00
				29 01 00 00 00 00 03 bc 1e 24
				29 01 00 00 00 00 03 bd 1c 22
				29 01 00 00 00 00 03 be 18 16
				29 01 00 00 00 00 03 bf 10 0a
				29 01 00 00 00 00 03 c0 08 2e
				29 01 00 00 00 00 03 c1 2e 2e
				29 01 00 00 00 00 03 c2 2e 2e
				29 01 00 00 00 00 03 c3 2e 2e

				29 01 00 00 00 00 03 e5 13 12
				29 01 00 00 00 00 03 c4 2e 2e
				29 01 00 00 00 00 03 c5 2e 2e
				29 01 00 00 00 00 03 c6 2e 2e
				29 01 00 00 00 00 03 c7 2e 02
				29 01 00 00 00 00 03 c8 00 18
				29 01 00 00 00 00 03 c9 12 10
				29 01 00 00 00 00 03 ca 24 1e
				29 01 00 00 00 00 03 cb 22 1c
				29 01 00 00 00 00 03 cc 0a 08
				29 01 00 00 00 00 03 cd 2e 2e
				29 01 00 00 00 00 03 ce 2e 2e
				29 01 00 00 00 00 03 cf 09 0b
				29 01 00 00 00 00 03 d0 1d 23
				29 01 00 00 00 00 03 d1 1f 25
				29 01 00 00 00 00 03 d2 11 13
				29 01 00 00 00 00 03 d3 19 01
				29 01 00 00 00 00 03 d4 03 2e
				29 01 00 00 00 00 03 d5 2e 2e
				29 01 00 00 00 00 03 d6 2e 2e
				29 01 00 00 00 00 03 d7 2e 2e
				29 01 00 00 00 00 03 e6 16 17

				29 01 00 00 00 00 06 d8 00 00
				00 00 00
				29 01 00 00 00 00 06 d9 00 00
				00 00 00

				29 01 00 00 00 00 02 e7 00
				29 01 00 00 00 00 06 f0 55 AA 
 				52 08 05 
 				29 01 00 00 00 00 02 ed 30

				29 01 00 00 00 00 06 f0 55 AA 
 				52 08 03
 				29 01 00 00 00 00 03 b0 20 00
 				29 01 00 00 00 00 03 b1 20 00

				29 01 00 00 00 00 06 f0 55 AA 
 				52 08 05
 				29 01 00 00 00 00 03 b0 17 06
 				29 01 00 00 00 00 02 b8 00
 				29 01 00 00 00 00 06 f0 55 AA 
 				52 08 03
 				29 01 00 00 00 00 03 b1 17 06
 				29 01 00 00 00 00 03 b9 00 03
 				29 01 00 00 00 00 03 b2 17 06
 				29 01 00 00 00 00 03 ba 00 03
 				29 01 00 00 00 00 03 b3 17 06
 				29 01 00 00 00 00 03 bb 00 00
 				29 01 00 00 00 00 03 b4 17 06
 				29 01 00 00 00 00 03 b5 17 06
 				29 01 00 00 00 00 03 b6 17 06
 				29 01 00 00 00 00 03 b7 17 06
 				29 01 00 00 00 00 03 bc 00 01
 				29 01 00 00 00 00 02 e5 06
 				29 01 00 00 00 00 02 e6 06
 				29 01 00 00 00 00 02 e7 06
				29 01 00 00 00 00 02 e8 06
				29 01 00 00 00 00 02 e9 0a
				29 01 00 00 00 00 02 ea 06
				29 01 00 00 00 00 02 eb 06
				29 01 00 00 00 00 02 ec 06
				29 01 00 00 00 00 06 f0 55 AA 
 				52 08 05
 				29 01 00 00 00 00 02 c0 07
 				29 01 00 00 00 00 02 c1 05
 				29 01 00 00 00 00 06 f0 55 AA 
 				52 08 03

				29 01 00 00 00 00 06 b2 04 00 
 				52 01 51
 				29 01 00 00 00 00 06 b3 04 00 
 				52 01 51
 				29 01 00 00 00 00 06 f0 55 AA 
 				52 08 05
 				29 01 00 00 00 00 02 c4 82
 				29 01 00 00 00 00 02 c5 80
 				29 01 00 00 00 00 06 f0 55 AA 
 				52 08 03
 				29 01 00 00 00 00 06 b6 04 00 
 				52 01 51
 				29 01 00 00 00 00 06 b7 04 00 
 				52 01 51
 				29 01 00 00 00 00 06 f0 55 AA 
 				52 08 05
				29 01 00 00 00 00 03 c8 03 20
				29 01 00 00 00 00 03 c9 01 21
				29 01 00 00 00 00 03 ca 03 20
				29 01 00 00 00 00 03 cb 07 20
				29 01 00 00 00 00 06 f0 55 AA 
 				52 08 03
 				29 01 00 00 00 00 06 ba 44 00 
 				60 01 72
 				29 01 00 00 00 00 06 bb 44 00 
 				60 01 72
 				29 01 00 00 00 00 06 bc 53 00 
 				03 00 48
 				29 01 00 00 00 00 06 bd 53 00 
 				03 00 48
 				29 01 00 00 00 00 06 f0 55 AA 
 				52 08 05

				29 01 00 00 00 00 0c D1 03 05 
 				00 05 00 00 00 00 00 00 00 
 				29 01 00 00 00 00 0c D2 03 05 
 				00 03 00 00 00 00 00 00 00 
 				29 01 00 00 00 00 0c D3 00 05 
 				04 05 00 00 00 00 00 00 00 
 				29 01 00 00 00 00 0c D4 00 05 
 				04 03 00 00 00 00 00 00 00 

				29 01 00 00 00 00 06 f0 55 AA 
 				52 08 03
 				29 01 00 00 00 00 02 c4 40
 				29 01 00 00 00 00 02 c5 40
 				29 01 00 00 00 00 06 f0 55 AA 
 				52 08 00
 				29 01 00 00 00 00 03 d9 00 01
 				29 01 00 00 00 00 02 6f 08
 				29 01 00 00 00 00 02 f2 70
 				29 01 00 00 00 00 02 6f 02
 				29 01 00 00 00 00 02 b8 08
 				29 01 00 00 00 00 02 6f 07
 				29 01 00 00 00 00 02 f4 f0
 				29 01 00 00 00 00 11 CC 80 3e
 				87 00 00 00 00 00 00 00 00 00
 				00 00 00 05
 				29 01 00 00 00 00 06 f0 55 AA 
 				52 08 01
 				29 01 00 00 00 00 02 cb 92
 				29 01 00 00 00 00 02 cd 08
 				29 01 00 00 00 00 02 6f 01
 				29 01 00 00 00 00 02 cd 01
 				29 01 00 00 00 00 02 6f 01
 				29 01 00 00 00 00 02 cb 8a
 				29 01 00 00 00 00 02 bf 60
 				29 01 00 00 00 00 02 d3 40
 				29 01 00 00 00 00 02 6f 11
 				29 01 00 00 00 00 02 f3 01
 				
 				
				
				05 01 00 00 78 00 02 11 00
				05 01 00 00 14 00 02 29 00
				
				29 01 00 00 00 00 02 53 2c
				29 01 00 00 00 00 02 55 03
				];
		qcom,mdss-dsi-off-command = [05 01 00 00 00 00 02 28 00
					05 01 00 00 00 00 02 10 00];
		qcom,mdss-dsi-on-command-state = "dsi_lp_mode";
		qcom,mdss-dsi-off-command-state = "dsi_hs_mode";
		qcom,mdss-dsi-h-sync-pulse = <1>;
		qcom,mdss-dsi-traffic-mode = "burst_mode";
		qcom,mdss-dsi-lane-map = <0>;
		qcom,mdss-dsi-bllp-eof-power-mode;
		qcom,mdss-dsi-bllp-power-mode;
		qcom,mdss-dsi-lane-0-state;
		qcom,mdss-dsi-lane-1-state;
		qcom,mdss-dsi-lane-2-state;
		qcom,mdss-dsi-lane-3-state;
		qcom,mdss-dsi-panel-timings = [8d 24 19 00 34 34 1d 26 2a 03 04 00];
		qcom,mdss-dsi-t-clk-post = <0x1f>;
		qcom,mdss-dsi-t-clk-pre = <0x2d>;
		qcom,mdss-dsi-bl-min-level = <1>;
		qcom,mdss-dsi-bl-max-level = <255>;
		qcom,mdss-dsi-dma-trigger = "trigger_sw";
		qcom,mdss-dsi-mdp-trigger = "none";
		qcom,mdss-dsi-bl-pmic-control-type = "bl_ctrl_dcs";
		qcom,mdss-dsi-pan-enable-dynamic-fps;
		qcom,mdss-dsi-pan-fps-update = "dfps_suspend_resume_mode";
		qcom,mdss-dsi-reset-sequence = <1 5>, <0 5>, <1 5>;
	};
};
